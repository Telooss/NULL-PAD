## firmware/module/Kconfig
```kconfig
DT_COMPAT_ZMK_BEHAVIOR_NP_SENSOR_KEYS := zmk,behavior-np-sensor-keys

config ZMK_BEHAVIOR_NP_SENSOR_KEYS
    bool
    default $(dt_compat_enabled,$(DT_COMPAT_ZMK_BEHAVIOR_NP_SENSOR_KEYS))
```

## firmware/module/dts/bindings/behaviors/zmk,behavior-np-sensor-keys.yaml
```yaml
description: Molette -> appui puis relachement d'une position de touche cachee, par cran

compatible: "zmk,behavior-np-sensor-keys"

properties:
  "#sensor-binding-cells":
    type: int
    required: true
    const: 2

sensor-binding-cells:
  - param1
  - param2
```
